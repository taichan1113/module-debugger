## boards/shields/module_tester/Kconfig.defconfig
```kconfig
if SHIELD_MODULE_TESTER

config ZMK_KEYBOARD_NAME
    default "module_tester"

endif

if ZMK_BACKLIGHT

config PWM
    default y

config LED_PWM
    default y

endif # ZMK_BACKLIGHT
```

## config/west.yml
```yaml
manifest:
  defaults:
    revision: v0.3
  remotes:
    - name: zmkfirmware
      url-base: https://github.com/zmkfirmware
    - name: caksoylar
      url-base: https://github.com/caksoylar
    - name: badjeff
      url-base: https://github.com/badjeff
    - name: sekigon-gonnoc
      url-base: https://github.com/sekigon-gonnoc
    - name: BP
      url-base: https://github.com/taichan1113

  projects:
    - name: zmk
      remote: zmkfirmware
      revision: v0.3
      import: app/west.yml

    - name: zmk-rgbled-widget  # https://github.com/caksoylar/zmk-rgbled-widget
      remote: caksoylar
      revision: v0.3-branch
      # revision: main

    - name: zmk-pmw3610-driver # https://github.com/badjeff/zmk-pmw3610-driver
      remote: badjeff
      revision: main

    - name: zmk-driver-paw3222
      remote: sekigon-gonnoc
      revision: main

    - name: zmk-driver-pat9125 # https://github.com/taichan1113/zmk-driver-pat9125
      remote: BP
      revision: main

    - name: zmk-input-processor-report-rate-limit # https://github.com/badjeff/zmk-input-processor-report-rate-limit
      remote: badjeff
      revision: main

    - name: zmk-input-processor-xyz
      remote: badjeff
      revision: main

  self:
    path: config
```
