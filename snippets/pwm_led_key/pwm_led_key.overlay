/ {
    chosen {
        zmk,backlight = &backlight;
    };
};

/delete-node/ &kscan0;

/ {
    kscan0: kscan0 {
        compatible = "zmk,kscan-gpio-direct";
        wakeup-source;
        input-gpios = <&gpio1 12 (GPIO_ACTIVE_LOW | GPIO_PULL_UP)>;
    };
};
