#include <zephyr/dt-bindings/input/input-event-codes.h>
#include <dt-bindings/zmk/input_transform.h>
#include <input/processors.dtsi>
// #include <input/processors/xyz.dtsi>
#include "../pinctrl_spi.dtsi"
#include "../listeners.dtsi"

&spi0 {
    status = "okay";
    compatible = "nordic,nrf-spim";
    pinctrl-0 = <&spi0_default>;
    pinctrl-1 = <&spi0_sleep>;
    pinctrl-names = "default", "sleep";
    cs-gpios = <&gpio1 12 GPIO_ACTIVE_LOW>;

    trackball_paw3222: trackball_paw3222@0 {
        status = "okay";
        compatible = "pixart,paw3222";
        reg = <0>;
        spi-max-frequency = <1500000>;
        irq-gpios = <&gpio0 5 (GPIO_ACTIVE_LOW | GPIO_PULL_UP)>;
        res-cpi = <800>;
        force-awake;
    };
};

&listener_central {
    status = "okay";
    device = <&trackball_paw3222>;
    input-processors
        = <&zip_xy_transform INPUT_TRANSFORM_X_INVERT>
        , <&zip_xy_transform INPUT_TRANSFORM_Y_INVERT>
        , <&zip_xy_scaler 3 2>
        ;

    scroller {
        layers = <1>;
        input-processors
            = <&zip_xy_transform INPUT_TRANSFORM_X_INVERT>
            , <&zip_xy_to_scroll_mapper>
            , <&zip_scroll_scaler 3 2>
            ;
    };
};

// &listener_peripheral {
//     status = "okay";
//     device = <&split_peripheral>;
//     input-processors
//         = <&zip_zxy>
//         , <&zip_xy_swap_mapper>
//         , <&zip_x_scaler 2 1>
//         , <&zip_y_scaler 2 1>
//         , <&zip_xy_to_scroll_mapper>
//         ;
// };
