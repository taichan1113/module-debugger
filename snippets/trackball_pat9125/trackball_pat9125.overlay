#include <zephyr/dt-bindings/input/input-event-codes.h>
#include <input/processors.dtsi>
// #include <input/processors/report_rate_limit.dtsi>
// #include <input/processors/xyz.dtsi>
#include "../pinctrl_i2c.dtsi"
#include "../listeners.dtsi"

&i2c1 {
    status = "okay";
    compatible = "nordic,nrf-twim";
    pinctrl-0 = <&i2c1_default>;
    pinctrl-1 = <&i2c1_sleep>;
    pinctrl-names = "default", "sleep";

    trackball_pat9125: trackball_pat9125@79 {
        status = "okay";
        compatible = "pixart,pat9125";
        reg = <0x79>; // HIGH:0x73, LOW:0x75, NC:0x79
        motion-gpios = <&gpio1 13 (GPIO_ACTIVE_LOW | GPIO_PULL_UP)>;
        res-x-cpi = <300>;
        res-y-cpi = <300>;
        zephyr,axis-x = <INPUT_REL_Y>;
        zephyr,axis-y = <INPUT_REL_X>;
        invert-x;
		invert-y;
        sleep1-enable;
        sleep2-enable;
    };
};

&listener_central {
    status = "okay";
    device = <&trackball_pat9125>;
    input-processors
        = <&zip_xy_to_scroll_mapper>
        , <&zip_scroll_scaler 1 10>
        // , <&zip_xyz>
        ;
};
