#include <zephyr/dt-bindings/input/input-event-codes.h>
#include <dt-bindings/zmk/input_transform.h>
#include <input/processors.dtsi>
// #include <input/processors/report_rate_limit.dtsi>
// #include <input/processors/xyz.dtsi>
#include "../pinctrl_spi.dtsi"
#include "../listeners.dtsi"

&spi0 {
    status = "okay";
    compatible = "nordic,nrf-spim";
    pinctrl-0 = <&spi0_default>;
    pinctrl-1 = <&spi0_sleep>;
    pinctrl-names = "default", "sleep";
    cs-gpios = <&gpio1 12 GPIO_ACTIVE_LOW>;

    trackball_pmw3610: trackball@0 {
        status = "okay";
        compatible = "pixart,pmw3610";
        reg = <0>;
        spi-max-frequency = <1500000>;
        irq-gpios = <&gpio1 14 (GPIO_ACTIVE_LOW | GPIO_PULL_UP)>;
        cpi = <800>;
        evt-type = <INPUT_EV_REL>;
        x-input-code = <INPUT_REL_X>;
        y-input-code = <INPUT_REL_Y>;
        force-awake;
    };
};

&listener_central {
    status = "okay";
    device = <&trackball_pmw3610>;
    input-processors
        = <&zip_xy_transform INPUT_TRANSFORM_X_INVERT>
        ;

    // scroller {
    //     layers = <1>;
    //     input-processors
    //         = <&zip_xy_transform INPUT_TRANSFORM_X_INVERT>
    //         , <&zip_xy_transform INPUT_TRANSFORM_Y_INVERT>
    //         , <&zip_xy_to_scroll_mapper>
    //         ;
    // };
};

// &listener_peripheral {
//     status = "okay";
//     device = <&split_peripheral>;
//     input-processors
//         = <&zip_zxy>
//         , <&zip_report_rate_limit 8>
//         , <&zip_xy_to_scroll_mapper>
//         , <&zip_scroll_scaler 3 1>
//         ;
// };
