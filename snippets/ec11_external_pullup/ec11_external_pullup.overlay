&encoder {
    status = "okay";
    a-gpios = <&gpio1 13 GPIO_ACTIVE_HIGH>;
    b-gpios = <&gpio1 12 GPIO_ACTIVE_HIGH>;
    steps = <60>;
};

/delete-node/ &kscan0;

/ {
    kscan0: kscan0 {
        compatible = "zmk,kscan-gpio-direct";
        wakeup-source;
        input-gpios = <&gpio1 15 (GPIO_ACTIVE_LOW | GPIO_PULL_UP)>;
    };
};